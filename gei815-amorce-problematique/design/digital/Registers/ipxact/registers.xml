# registers: IP-XACT component
VLNV vendor:library:registers:version

## Address spaces and blocks
registers.registers: base 0, range 10, width 32

## Registers
Registers are 1-bit, read-write, no defined reset value unless marked. A register's access mark holds for its fields unless they carry their own. Offsets are from the block's base; lines under a group give offsets from that group; [hi:lo] are bit positions; {n}, {i} and the like mark numbered series; 'fields as' and 'values as' point back to an identical list; <NAME> marks a mode.

## registers.registers
Base 0x00000000
0x00 DataMode 2-bit — The mode for the data acquisition
  [1:0] Mode — Mode : 0 => Debug, 1 => compact, 2,3 => nothing for now
0x01 TensionMode 2-bit — Tension mode of the FPGA
  [1:0] Mode — Mode : 0 => low, 1 => high, 2,3 => nothing for now
0x02 EnableCntRate — Enable the count rate of all events
  [0] Enable — 1 => true, 0 => false
0x03 EnableEventCntRate — Enable the count rate for only good events
  [0] Enable — 1 => true, 0 => false
0x04 Threshold 32-bit — Threshold for the TDC
  [31:0] Value — the value of the Threshold
0x05 SrcSelected — Choose between the SiPM source and Test_Pulse
  [0] Mode — Mode : 0 => SiPM, 1 => Test_Pulse
0x06 FlagSyncError ro — Flag error that represent a problem of sync with the other FPGA
  [0] Value — 0 => No error, 1 => Error
0x07 DisableFlagSync — Disable the flag Sync error, also generate a pulse...
  [0] Mode — 0 => Nothing, 1 => Put FalgSyncError to 0 and send a pulse
0x08 ActiveChannels 17-bit reset 0xFFFF — Active channels for the SIPM
  [0] MasterSwitch — Activate all channels
  [15:0] ChannelEnable — Channels goes from 0 to 15, Activate the channel with the values of bits
0x09 ProductKey 32-bit reset 0xBADEFACE — Constant value to identify project
  [31:0] Value — Constant value
